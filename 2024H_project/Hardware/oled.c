#include "oled.h"
#include "board.h"   /* delay_ms / delay_us */

/*
 * SSD1306 over 4-wire software SPI. Data is shifted MSB-first on the rising
 * edge of SCL (SPI mode 0). DC selects command (low) vs data (high).
 */

#define OLED_RST_HIGH()  DL_GPIO_setPins(OLED_RST_PORT, OLED_RST_PIN)
#define OLED_RST_LOW()   DL_GPIO_clearPins(OLED_RST_PORT, OLED_RST_PIN)
#define OLED_DC_HIGH()   DL_GPIO_setPins(OLED_DC_PORT,  OLED_DC_PIN)
#define OLED_DC_LOW()    DL_GPIO_clearPins(OLED_DC_PORT, OLED_DC_PIN)
#define OLED_SCL_HIGH()  DL_GPIO_setPins(OLED_SCL_PORT, OLED_SCL_PIN)
#define OLED_SCL_LOW()   DL_GPIO_clearPins(OLED_SCL_PORT, OLED_SCL_PIN)
#define OLED_SDA_HIGH()  DL_GPIO_setPins(OLED_SDA_PORT, OLED_SDA_PIN)
#define OLED_SDA_LOW()   DL_GPIO_clearPins(OLED_SDA_PORT, OLED_SDA_PIN)

/* 6x8 ASCII font, columns left-to-right, each byte bit0=top row..bit7=bottom.
 * Covers printable ASCII 0x20..0x7E. */
static const uint8_t OLED_F6x8[][6] = {
    {0x00,0x00,0x00,0x00,0x00,0x00}, /* sp */
    {0x00,0x00,0x2F,0x00,0x00,0x00}, /* ! */
    {0x00,0x07,0x00,0x07,0x00,0x00}, /* " */
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    {0x08,0x04,0x08,0x10,0x08,0x00}, /* ~ */
};

/* Shift one byte out MSB-first (SPI mode 0). */
static void OLED_WriteByte(uint8_t dat, uint8_t is_cmd)
{
    uint8_t i;

    if (is_cmd)
        OLED_DC_LOW();
    else
        OLED_DC_HIGH();

    for (i = 0; i < 8; i++)
    {
        OLED_SCL_LOW();
        if (dat & 0x80)
            OLED_SDA_HIGH();
        else
            OLED_SDA_LOW();
        OLED_SCL_HIGH();   /* sample on rising edge */
        dat <<= 1;
    }
    OLED_SCL_HIGH();
}

static void OLED_WriteCmd(uint8_t cmd)  { OLED_WriteByte(cmd, 1); }
static void OLED_WriteData(uint8_t dat) { OLED_WriteByte(dat, 0); }

void OLED_SetCursor(uint8_t x, uint8_t y)
{
    uint8_t col = x * OLED_CHAR_W;     /* char cell -> pixel column */

    if (y >= OLED_PAGES) y = OLED_PAGES - 1;
    if (col >= OLED_COLS) col = OLED_COLS - 1;

    OLED_WriteCmd(0xB0 + y);                 /* page address */
    OLED_WriteCmd(0x00 + (col & 0x0F));      /* lower column nibble */
    OLED_WriteCmd(0x10 + (col >> 4));        /* upper column nibble */
}

void OLED_Clear(void)
{
    uint8_t page, col;

    for (page = 0; page < OLED_PAGES; page++)
    {
        OLED_WriteCmd(0xB0 + page);
        OLED_WriteCmd(0x00);
        OLED_WriteCmd(0x10);
        for (col = 0; col < OLED_COLS; col++)
            OLED_WriteData(0x00);
    }
}

void OLED_ShowChar(uint8_t x, uint8_t y, char ch)
{
    uint8_t i;
    uint8_t idx;

    if (ch < 0x20 || ch > 0x7E) ch = ' ';
    idx = (uint8_t)(ch - 0x20);

    OLED_SetCursor(x, y);
    for (i = 0; i < OLED_CHAR_W; i++)
        OLED_WriteData(OLED_F6x8[idx][i]);
}

void OLED_ShowString(uint8_t x, uint8_t y, const char *str)
{
    while (*str != '\0')
    {
        OLED_ShowChar(x, y, *str++);
        x++;
        if (x > 20)            /* wrap to next line */
        {
            x = 0;
            y++;
            if (y >= OLED_PAGES) y = 0;
        }
    }
}

void OLED_ShowNum(uint8_t x, uint8_t y, uint32_t num, uint8_t len)
{
    char buf[11];
    uint8_t i;

    if (len > 10) len = 10;
    for (i = 0; i < len; i++)
    {
        buf[len - 1 - i] = (char)('0' + (num % 10));
        num /= 10;
    }
    /* blank leading zeros */
    for (i = 0; i < (uint8_t)(len - 1); i++)
    {
        if (buf[i] == '0')
            buf[i] = ' ';
        else
            break;
    }
    buf[len] = '\0';
    OLED_ShowString(x, y, buf);
}

void OLED_ShowTenths(uint8_t x, uint8_t y, int32_t value_x10, uint8_t int_len)
{
    char buf[14];
    uint8_t p = 0;
    uint32_t mag;
    uint8_t i, digits;
    char tmp[10];

    if (value_x10 < 0)
    {
        buf[p++] = '-';
        mag = (uint32_t)(-value_x10);
    }
    else
    {
        mag = (uint32_t)value_x10;
    }

    /* integer part = mag/10, fraction = mag%10 */
    {
        uint32_t ip = mag / 10U;
        digits = 0;
        do {
            tmp[digits++] = (char)('0' + (ip % 10U));
            ip /= 10U;
        } while (ip && digits < (uint8_t)sizeof(tmp));
    }

    /* right-justify integer part to int_len with leading spaces */
    if (int_len > digits)
    {
        for (i = 0; i < (uint8_t)(int_len - digits); i++)
            buf[p++] = ' ';
    }
    for (i = 0; i < digits; i++)
        buf[p++] = tmp[digits - 1 - i];

    buf[p++] = '.';
    buf[p++] = (char)('0' + (mag % 10U));
    buf[p] = '\0';

    OLED_ShowString(x, y, buf);
}

void OLED_Init(void)
{
    /* Hardware reset pulse. */
    OLED_RST_HIGH();
    delay_ms(10);
    OLED_RST_LOW();
    delay_ms(20);
    OLED_RST_HIGH();
    delay_ms(20);

    OLED_WriteCmd(0xAE);   /* display off */
    OLED_WriteCmd(0x20);   /* memory addressing mode */
    OLED_WriteCmd(0x10);   /*   page addressing mode */
    OLED_WriteCmd(0xB0);   /* page start */
    OLED_WriteCmd(0xC8);   /* COM scan dir remapped */
    OLED_WriteCmd(0x00);   /* low column */
    OLED_WriteCmd(0x10);   /* high column */
    OLED_WriteCmd(0x40);   /* start line 0 */
    OLED_WriteCmd(0x81);   /* contrast */
    OLED_WriteCmd(0xFF);
    OLED_WriteCmd(0xA1);   /* segment remap */
    OLED_WriteCmd(0xA6);   /* normal (not inverted) */
    OLED_WriteCmd(0xA8);   /* multiplex ratio */
    OLED_WriteCmd(0x3F);   /*   1/64 duty */
    OLED_WriteCmd(0xA4);   /* output follows RAM */
    OLED_WriteCmd(0xD3);   /* display offset */
    OLED_WriteCmd(0x00);
    OLED_WriteCmd(0xD5);   /* clock divide */
    OLED_WriteCmd(0xF0);
    OLED_WriteCmd(0xD9);   /* pre-charge */
    OLED_WriteCmd(0x22);
    OLED_WriteCmd(0xDA);   /* COM pins */
    OLED_WriteCmd(0x12);
    OLED_WriteCmd(0xDB);   /* VCOM detect */
    OLED_WriteCmd(0x20);
    OLED_WriteCmd(0x8D);   /* charge pump */
    OLED_WriteCmd(0x14);   /*   enable */
    OLED_WriteCmd(0xAF);   /* display on */

    OLED_Clear();
}
